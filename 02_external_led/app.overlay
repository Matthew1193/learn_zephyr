/ {
    aliases {
        external-led = &my_ext_led;
    };

    my_external_leds {
        compatible = "gpio-leds";

        my_ext_led: led_external {
            gpios = <&gpio3 31 GPIO_ACTIVE_HIGH>;
            label = "External LED";
        };
    };
};